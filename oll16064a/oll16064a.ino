
#define OLL_PIN_DR2 PB12
#define OLL_PIN_CL2 PB13
#define OLL_PIN_CL1 PB14
#define OLL_PIN_M   PB15
#define OLL_PIN_DL1 PA8

uint8_t row, col, dat, i;

uint8_t frame[] = {
  0x00, 0x00, 0x00, 0x00, 0x00, 0x00, 0x00, 0x00, 0x00, 0x00, 0x00, 0x00, 0x00, 0x00, 0x00, 0x00,
  0x00, 0x00, 0x00, 0x00, 0x00, 0x00, 0x00, 0x30, 0x00, 0x00, 0x00, 0x00, 0x00, 0x00, 0x00, 0x00,
  0x00, 0x00, 0x00, 0x00, 0x00, 0x00, 0x00, 0x00, 0x00, 0x00, 0x00, 0x68, 0x00, 0x00, 0x00, 0x00,
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  0x00, 0x00, 0x00, 0x00, 0x00, 0x00, 0x00, 0x01, 0x01, 0x83, 0xF0, 0x38, 0x00, 0x40, 0x10, 0x00

};

void oll_init() {
  pinMode(OLL_PIN_DR2,  OUTPUT);
  pinMode(OLL_PIN_CL2,  OUTPUT);
  pinMode(OLL_PIN_CL1,  OUTPUT);
  pinMode(OLL_PIN_M,    OUTPUT);
  pinMode(OLL_PIN_DL1,  OUTPUT);

  digitalWrite(OLL_PIN_DR2, LOW);
  digitalWrite(OLL_PIN_CL2, LOW);
  digitalWrite(OLL_PIN_CL1, LOW);
  digitalWrite(OLL_PIN_M,   LOW);
  digitalWrite(OLL_PIN_DL1, LOW);
}

void oll_write_frame(uint8_t* frm) {
  digitalWrite(OLL_PIN_CL1, !digitalRead(OLL_PIN_CL1));
  digitalWrite(OLL_PIN_DL1, !digitalRead(OLL_PIN_DL1));
  digitalWrite(OLL_PIN_CL1, !digitalRead(OLL_PIN_CL1));
  digitalWrite(OLL_PIN_DL1, !digitalRead(OLL_PIN_DL1));
  digitalWrite(OLL_PIN_M, !digitalRead(OLL_PIN_M));
  for (row = 0; row < 64; row++) {
    if (row == 0) {
      digitalWrite(OLL_PIN_DL1, HIGH);
    }
    for (col = 0; col < 20; col++) {
      dat = *frm++;
      for (i = 0; i < 8; i++) {
        digitalWrite(OLL_PIN_CL2, HIGH);
        digitalWrite(OLL_PIN_DR2, dat & 0xF0);
        digitalWrite(OLL_PIN_CL2, LOW);
        dat = dat << 1;
      }
    }
    digitalWrite(OLL_PIN_CL1, HIGH);
    digitalWrite(OLL_PIN_CL1, LOW);
    if (row == 0) {
      digitalWrite(OLL_PIN_DL1, LOW);
    }
  }
}

void setup() {
  oll_init();
}

void loop() {
  oll_write_frame(frame);
}
